#include "viewer.h"

#define OLED_CMD  0
#define OLED_DATA 1


const unsigned char F6x8[][6] =		
{
0x00, 0x00, 0x00, 0x00, 0x00, 0x00,// sp
0x00, 0x00, 0x00, 0x2f, 0x00, 0x00,// !
0x00, 0x00, 0x07, 0x00, 0x07, 0x00,// "
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0x14, 0x14, 0x14, 0x14, 0x14, 0x14,// horiz lines
};


/**
		==== hardware function ====
*/
/**
	@brief soft iic start signal
	@param void
	
	@return void
*/
void soft_iic_start()
{
	gpio_iic_scl_set();
	gpio_iic_sda_set();
	gpio_iic_sda_reset();
	gpio_iic_scl_reset();
}

/**
	@brief soft iic stop signal
	@param void
	
	@return void
*/
void soft_iic_stop()
{
	gpio_iic_scl_set();
	gpio_iic_sda_reset();
	gpio_iic_sda_set();
}

/**
	@brief soft iic wait for ack signal
	@param void
	
	@return void
*/
void soft_iic_wait_ack()
{
	gpio_iic_scl_set();
	gpio_iic_scl_reset();
}

/**
	@brief soft iic write byte
	@param byte
	
	@return void
*/
void soft_iic_write_byte(uint8_t _Byte)
{
	uint8_t iter, bit ;
	gpio_iic_scl_reset();
	for(iter=0;iter<8;iter++)		
	{
		bit = _Byte;
		bit = bit & 0x80;
		if( bit == 0x80 ) gpio_iic_sda_set();
		else gpio_iic_sda_reset();
		_Byte = _Byte <<1;
		gpio_iic_scl_set();
		gpio_iic_scl_reset();
	}
}


/**
		==== oled function ====
*/
/**
	@brief write command to oled , device address is 0x78 , register address is 0x00
	@param byte
	
	@return void
*/
void oled_write_cmd(uint8_t _command)
{
  soft_iic_start();
  soft_iic_write_byte(0x78);
	soft_iic_wait_ack();	
  soft_iic_write_byte(0x00);
	soft_iic_wait_ack();	
  soft_iic_write_byte(_command); 
	soft_iic_wait_ack();	
  soft_iic_stop();
}

/**
	@brief write data to oled , device address is 0x78 , register address is 0x00
	@param byte
	
	@return void
*/
void oled_write_data(uint8_t _data)
{
  soft_iic_start();
  soft_iic_write_byte(0x78);
	soft_iic_wait_ack();	
  soft_iic_write_byte(0x40);
	soft_iic_wait_ack();	
  soft_iic_write_byte(_data); 
	soft_iic_wait_ack();	
  soft_iic_stop();
}

/*
	  ==== application ====
*/
/**
	@brief set configs to the oled
	@param void
	
	@return void
*/
void oled_set_config(void)
{ 	
	oled_write_cmd(0xAE);//--display off
	oled_write_cmd(0x02);//---set low column address
	oled_write_cmd(0x10);//---set high column address
	oled_write_cmd(0x40);//--set start line address  
	oled_write_cmd(0xB0);//--set page address
	oled_write_cmd(0x81); // contract control
	oled_write_cmd(0xFF);//--128   
	oled_write_cmd(0xA1);//set segment remap 
	oled_write_cmd(0xA6);//--normal / reverse
	oled_write_cmd(0xA8);//--set multiplex ratio(1 to 64)
	oled_write_cmd(0x3F);//--1/32 duty
	oled_write_cmd(0xC8);//Com scan direction
	oled_write_cmd(0xD3);//-set display offset
	oled_write_cmd(0x00);//
	oled_write_cmd(0xD5);//set osc division
	oled_write_cmd(0x80);//
	oled_write_cmd(0xD8);//set area color mode off
	oled_write_cmd(0x05);//
	oled_write_cmd(0xD9);//Set Pre-Charge Period
	oled_write_cmd(0xF1);//
	oled_write_cmd(0xDA);//set com pin configuartion
	oled_write_cmd(0x12);//
	oled_write_cmd(0xDB);//set Vcomh
	oled_write_cmd(0x30);//
	oled_write_cmd(0x8D);//set charge pump enable
	oled_write_cmd(0x14);//
	oled_write_cmd(0xAF);//--turn on oled panel
}  

/**
	@brief set configs to the oled
	@param void
	
	@return void
*/
void oled_set_pose(uint8_t _col, uint8_t _page) 
{ 
	oled_write_cmd(0xb0 + _page);
	oled_write_cmd(( 0x10| ((_col+2)&0xf0)>>4));
	oled_write_cmd(( (_col+2)&0x0f)); 
} 

/**
	@brief show single asscii char
	@param void
	
	@return void
*/
void oled_show_single_asscii(uint8_t _col, uint8_t _page, uint8_t _char)
{
	_char = _char - ' ';
	if(_col>127-6) _col=0;
	
	oled_set_pose(_col , _page);
	for(uint8_t iter=0 ; iter<6 ; iter++)
	oled_write_data(F6x8[_char][iter]);
}

/**
	@brief show strings in line
	@param void
	
	@return void
*/
void oled_show_multi_asscii(uint8_t _col , uint8_t _page , uint8_t* _ptr_data , uint8_t _len , uint8_t _speed)
{
	for(int iter = 0; iter<_len ; iter++)
	{
		oled_show_single_asscii(_col + iter*6 , _page , _ptr_data[iter]);
		delay_ms(_speed);
	}
}

/**
	@brief oled fill screen
	@param byte
	
	@return void
*/
void oled_fill_screen(uint8_t _fill_Data)
{
	unsigned char page , col ;
	for(page=0 ; page<8 ; page++)
	{
		oled_set_pose(0,page);
		for(col=0 ; col<128 ; col++) oled_write_data(_fill_Data);
	}
}

/**
	@brief oled show line by line
	@param void
	
	@return void
*/
void oled_show_line_by_line()
{
	uint8_t page , col;
	for(page = 0 ; page < 8 ; page++){
		oled_fill_screen(0x00);
		oled_set_pose(0,page);
		for(int n=0;n<128;n++)
		{
				oled_write_data(0xff);
				delay_ms(50);
		}
		delay_ms(500);
	}
}

void oled_show_start_info()
{
	oled_fill_screen(0x00);
	uint8_t data_0[] = "XiaoMaAirFly  -v0.1.3";
	oled_show_multi_asscii(0,0,data_0,21,10);
	
	uint8_t data_1[] = "  by MianZhi";
	oled_show_multi_asscii(0,1,data_1,12,10);
	
	uint8_t data_2[] = "  by Wincent";
	oled_show_multi_asscii(0,2,data_2,12,10);
	
	uint8_t data_4[] = "System init:";
	oled_show_multi_asscii(0,4,data_4,12,10);
	
	uint8_t data_6[] = "LOG:imu starting...";
	oled_show_multi_asscii(0,6,data_6,19,10);
	
	uint8_t data_7[] = "LOG:imu has init";
	oled_show_multi_asscii(0,7,data_7,16,5);
}


void oled_init()
{
	oled_set_config();
	oled_fill_screen(0xff);
	HAL_Delay(500);
	oled_fill_screen(0x00);
	oled_show_start_info();
}


